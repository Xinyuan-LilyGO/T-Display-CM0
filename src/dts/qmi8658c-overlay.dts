/dts-v1/;
/plugin/;

/ {
	compatible = "brcm,bcm2835";

	fragment@0 {
		target = <&i2c1>;

		__overlay__ {
			status = "okay";
			#address-cells = <1>;
			#size-cells = <0>;

			qmi8658c: imu@6a {
				compatible = "qst,qmi8658c";
				reg = <0x6a>;
			};
		};
	};
};

