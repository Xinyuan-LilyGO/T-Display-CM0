/dts-v1/;
/plugin/;
#include <dt-bindings/input/input.h>
#include <dt-bindings/interrupt-controller/irq.h>

/ {
    compatible = "brcm,bcm2835";

    fragment@0 {
        target = <&i2c1>;
        __overlay__ {
            #address-cells = <1>;
            #size-cells = <0>;
            status = "okay";

            keypad@34{
                compatible = "ti,tca8418";
                reg = <0x34>;
                interrupt-parent = <&gpio>;
                interrupts = <23 IRQ_TYPE_EDGE_FALLING>;

                keypad,num-rows = <7>;
                keypad,num-columns = <10>;

                linux,keymap = <                
                     /* ── ROW 0: 功能/修饰键 ── */
                    MATRIX_KEY(0, 0, KEY_RIGHT)
                    MATRIX_KEY(0, 1, KEY_LEFT)
                    MATRIX_KEY(0, 2, KEY_FN)
                    MATRIX_KEY(0, 3, KEY_SPACE)
                    MATRIX_KEY(0, 4, KEY_SPACE)
                    MATRIX_KEY(0, 5, KEY_TAB)
                    MATRIX_KEY(0, 6, KEY_LEFTSHIFT)
                    MATRIX_KEY(0, 7, KEY_LEFTMETA)
                    MATRIX_KEY(0, 8, KEY_FN)
                    MATRIX_KEY(0, 9, KEY_CAPSLOCK)

                    /* ── ROW 1: 底行 + Z行 ── */
                    MATRIX_KEY(1, 0, KEY_VOICECOMMAND)  /* Voice 键 */
                    MATRIX_KEY(1, 1, KEY_DOWN)
                    MATRIX_KEY(1, 2, KEY_M)
                    MATRIX_KEY(1, 3, KEY_SPACE)
                    MATRIX_KEY(1, 4, KEY_V)
                    MATRIX_KEY(1, 5, KEY_C)
                    MATRIX_KEY(1, 6, KEY_X)
                    MATRIX_KEY(1, 7, KEY_Z)
                    MATRIX_KEY(1, 8, KEY_LEFTALT)
                    MATRIX_KEY(1, 9, KEY_Q)

                    /* ── ROW 2: A行 + 数字修饰 ── */
                    MATRIX_KEY(2, 0, KEY_ENTER)
                    MATRIX_KEY(2, 1, KEY_UP)
                    MATRIX_KEY(2, 2, KEY_LEFTCTRL)
                    MATRIX_KEY(2, 3, KEY_N)
                    MATRIX_KEY(2, 4, KEY_B)
                    MATRIX_KEY(2, 5, KEY_F)
                    MATRIX_KEY(2, 6, KEY_D)
                    MATRIX_KEY(2, 7, KEY_S)
                    MATRIX_KEY(2, 8, KEY_A)
                    MATRIX_KEY(2, 9, KEY_ESC)

                    /* ── ROW 3: G~L + W/E/R ── */
                    MATRIX_KEY(3, 1, KEY_L)
                    MATRIX_KEY(3, 2, KEY_K)
                    MATRIX_KEY(3, 3, KEY_J)
                    MATRIX_KEY(3, 4, KEY_H)
                    MATRIX_KEY(3, 5, KEY_G)
                    MATRIX_KEY(3, 6, KEY_R)
                    MATRIX_KEY(3, 7, KEY_E)
                    MATRIX_KEY(3, 8, KEY_W)
                    MATRIX_KEY(3, 9, KEY_ESC)

                    /* ── ROW 4: P~T + 1/2 + F1 ── */
                    MATRIX_KEY(4, 0, KEY_BACKSPACE)
                    MATRIX_KEY(4, 1, KEY_P)
                    MATRIX_KEY(4, 2, KEY_O)
                    MATRIX_KEY(4, 3, KEY_I)
                    MATRIX_KEY(4, 4, KEY_U)
                    MATRIX_KEY(4, 5, KEY_Y)
                    MATRIX_KEY(4, 6, KEY_T)
                    MATRIX_KEY(4, 7, KEY_2)
                    MATRIX_KEY(4, 8, KEY_1)
                    MATRIX_KEY(4, 9, KEY_F1)

                    /* ── ROW 5: 3~0 + F2/F3 ── */
                    MATRIX_KEY(5, 0, KEY_0)
                    MATRIX_KEY(5, 1, KEY_9)
                    MATRIX_KEY(5, 2, KEY_8)
                    MATRIX_KEY(5, 3, KEY_7)
                    MATRIX_KEY(5, 4, KEY_6)
                    MATRIX_KEY(5, 5, KEY_5)
                    MATRIX_KEY(5, 6, KEY_4)
                    MATRIX_KEY(5, 7, KEY_3)
                    MATRIX_KEY(5, 8, KEY_F3)
                    MATRIX_KEY(5, 9, KEY_F2)

                    /* ── ROW 6: F4~F11 ── */
                    MATRIX_KEY(6, 0, KEY_F11)
                    MATRIX_KEY(6, 1, KEY_F10)
                    MATRIX_KEY(6, 2, KEY_F9)
                    MATRIX_KEY(6, 3, KEY_F8)
                    MATRIX_KEY(6, 4, KEY_F7)
                    MATRIX_KEY(6, 5, KEY_F6)
                    MATRIX_KEY(6, 6, KEY_F5)
                    MATRIX_KEY(6, 7, KEY_F4)
                >;
            };
        };
    };
};
